## config/west.yml
```yaml
manifest:
  remotes:
    - name: zmkfirmware
      url: https://github.com
    - name: urob
      url: https://github.com
  projects:
    - name: zmk
      remote: zmkfirmware
      revision: main
      import: app/west.yml
    - name: zmk-unicode
      remote: urob
      revision: main
```
